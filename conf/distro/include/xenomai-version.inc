## conf/distro/include/xenomai-version.inc
```bitbake
#
# Xenomai Real-Time System
#
# Copyright (c) Siemens AG, 2019
#
# Authors:
#  Quirin Gylstorff <quirin.gylstorff@siemens.com>
#
# SPDX-License-Identifier: MIT
#

XENOMAI_NEXT_KERNEL_VERSION = "4.19%"
XENOMAI_STABLE_VERSION_LIST = "stable 3.0 3.0% 3.0.% 3.0.9"
XENOMAI_STABLE_KERNEL_VERSION = "4.14%"
# if PREFERRED_VERSION_xenomai contains any item from XENOMAI_STABLE_VERSION_LIST use
# XENOMAI_STABLE_KERNEL_VERSION
PREFERRED_VERSION_linux-xenomai ?= "${@bb.utils.contains_any('PREFERRED_VERSION_xenomai','${XENOMAI_STABLE_VERSION_LIST}','${XENOMAI_STABLE_KERNEL_VERSION}','${XENOMAI_NEXT_KERNEL_VERSION}',d) }"
```

## conf/distro/xenomai-demo.conf
```bitbake
#
# Xenomai Real-Time System
#
# Copyright (c) Siemens AG, 2018
#
# Authors:
#  Jan Kiszka <jan.kiszka@siemens.com>
#
# SPDX-License-Identifier: MIT
#

require conf/distro/debian-buster.conf
include conf/distro/include/xenomai-version.inc

HOST_DISTRO ?= "debian-buster"

KERNEL_NAME = "xenomai"

WKS_FILE = "${MACHINE}.wks"

USERS += "root"
# 'root'
USER_root[password] = "oC3wEGl799tZU"
```

## conf/layer.conf
```bitbake
#
# Xenomai Real-Time System
#
# Copyright (c) Siemens AG, 2018
#
# Authors:
#  Jan Kiszka <jan.kiszka@siemens.com>
#
# SPDX-License-Identifier: MIT
#

BBPATH .= ":${LAYERDIR}"

BBFILES += "${LAYERDIR}/recipes-*/*/*.bb \
        ${LAYERDIR}/recipes-*/*/*.bbappend"

BBFILE_COLLECTIONS += "xenomai"
BBFILE_PATTERN_xenomai = "^${LAYERDIR}/"
BBFILE_PRIORITY_xenomai = "6"

LAYERSERIES_COMPAT_xenomai = "next"

LAYERDIR_xenomai = "${LAYERDIR}"
```

## conf/machine/beagle-bone-black.conf
```bitbake
#
# Xenomai Real-Time System
#
# Copyright (c) Siemens AG, 2019
#
# Authors:
#  Quirin Gylstorff <quirin.gylstorff@siemens.com>
#
# SPDX-License-Identifier: MIT
#

DISTRO_ARCH = "armhf"

IMAGE_INSTALL += "u-boot-script"

IMAGE_TYPE ?= "wic-img"
DTB_FILE = "am335x-boneblack.dtb"
IMAGER_INSTALL += "u-boot-omap"
IMAGE_PREINSTALL += "fake-hwclock"
```

## conf/machine/hikey.conf
```bitbake
#
# Xenomai Real-Time System
#
# Copyright (c) Siemens AG, 2018
#
# Authors:
#  Jan Kiszka <jan.kiszka@siemens.com>
#
# SPDX-License-Identifier: MIT
#

DISTRO_ARCH = "arm64"

IMAGE_TYPE = "wic-img"
IMAGER_INSTALL += "${GRUB_BOOTLOADER_INSTALL}"

PREFERRED_VERSION_linux-xenomai = "4.14.%"

IMAGE_PREINSTALL_append = " firmware-ti-connectivity"

PREFERRED_VERSION_xenomai = "next"
```

## conf/machine/qemu-arm64.conf
```bitbake
#
# Xenomai Real-Time System
#
# Copyright (c) Siemens AG, 2018
#
# Authors:
#  Jan Kiszka <jan.kiszka@siemens.com>
#
# SPDX-License-Identifier: MIT
#

require qemu-machine.inc

DISTRO_ARCH = "arm64"
PREFERRED_VERSION_xenomai = "next"
PREFERRED_VERSION_linux-xenomai = "4.14.%"
```

## conf/machine/x86-64-efi.conf
```bitbake
#
# Xenomai Real-Time System
#
# Copyright (c) Siemens AG, 2019
#
# Authors:
#  Quirin Gylstorff <quirin.gylstorff@siemens.com>
#
# SPDX-License-Identifier: MIT
#

DISTRO_ARCH = "amd64"

IMAGE_TYPE = "wic-img"
IMAGER_INSTALL += "${GRUB_BOOTLOADER_INSTALL}"
```

## wic/beagle-bone-black.wks
```
#
# Xenomai Real-Time System
#
# Copyright (c) Siemens AG, 2019
#
# Authors:
#  Quirin Gylstorff <quirin.gylstorff@siemens.com>
#
# SPDX-License-Identifier: MIT
#

part --source rawcopy --sourceparams "file=/usr/lib/u-boot/am335x_boneblack/MLO" --no-table --align 128
part u-boot --source rawcopy --sourceparams "file=/usr/lib/u-boot/am335x_boneblack/u-boot.img" --no-table --align 384

part / --source rootfs-u-boot --ondisk mmcblk0 --fstype ext4 --label platform --align 1024 --active

bootloader --append "rw rootwait console=ttyO,115200"
```

## wic/x86-64-efi.wks
```
#
# Xenomai Real-Time System
#
# Copyright (c) Siemens AG, 2019
#
# Authors:
#  Quirin Gylstorff <quirin.gylstorff@siemens.com>
#
# SPDX-License-Identifier: MIT
#

part /boot --source bootimg-efi-isar --sourceparams "loader=grub-efi" --ondisk sda --label efi --part-type EF00 --align 1024

part / --source rootfs --ondisk sda --fstype ext4 --label platform --align 1024 --use-uuid

bootloader --ptable gpt --timeout=2 --append "rw rootwait console=ttyS0,115200"
```
